/*
 * CAUTION: This file is automatically generated by Xilinx.
 * Version: XSCT 2024.1
 * Today is: Tue Aug 12 21:55:18 2025
 */


/dts-v1/;
#include "zynqmp.dtsi"
#include "zynqmp-clk-ccf.dtsi"
#include "pcw.dtsi"
/ {
	chosen {
		bootargs = "earlycon";
	};
	aliases {
		serial0 = &dcc;
		spi0 = &qspi;
		spi1 = &spi1;
	};
	memory@0 {
		device_type = "memory";
		reg = <0x0 0x0 0x0 0x7ff00000>, <0x00000008 0x00000000 0x0 0x80000000>;
	};
};
